## components/InputLib/Kconfig.projbuild
```kconfig
menu "Line sensor"
	config GPIO_MULTIPLEXER_IN_0
		int "GPIO_MULTIPLEXER_IN_1"
		range 0 GPIO_RANGE_MAX
		default 13

	config GPIO_MULTIPLEXER_IN_1
		int "GPIO_MULTIPLEXER_IN_1"
		range 0 GPIO_RANGE_MAX
		default 12

	config GPIO_MULTIPLEXER_IN_2
		int "GPIO_MULTIPLEXER_IN_2"
		range 0 GPIO_RANGE_MAX
		default 26
					
	config GPIO_MULTIPLEXER_IN_3
		int "GPIO_MULTIPLEXER_IN_3"
		range 0 GPIO_RANGE_MAX
		default 27

	
	int GPIO_MULTIPLEXER_OUT
		int "там надо в даташит лезть"
		range 0 0
		default 0

endmenu
```

## sdkconfig.defaults
```kconfig
# Override some defaults so BT stack is enabled
CONFIG_BT_ENABLED=y
CONFIG_BTDM_CTRL_MODE_BLE_ONLY=n
CONFIG_BTDM_CTRL_MODE_BR_EDR_ONLY=y
CONFIG_BTDM_CTRL_MODE_BTDM=n
CONFIG_BT_CLASSIC_ENABLED=y
CONFIG_BT_SPP_ENABLED=y
CONFIG_BT_BLE_ENABLED=n
CONFIG_BT_HFP_ENABLE=y



CONFIG_GPIO_RANGE_MAX=33
CONFIG_I2C_INTERFACE=y
CONFIG_SSD1306_128x64=y
CONFIG_OFFSETX=2
CONFIG_SCL_GPIO=22
CONFIG_SDA_GPIO=21
CONFIG_RESET_GPIO=-1
CONFIG_I2C_PORT_0=y
CONFIG_LEGACY_DRIVER=y
```
